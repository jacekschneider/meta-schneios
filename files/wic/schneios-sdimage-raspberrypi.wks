## files/wic/schneios-sdimage-raspberrypi.wks
```
part /boot --source bootimg-partition --ondisk mmcblk0 --fstype=vfat --label boot --active --align 4096 --size 100
part / --source rootfs --fixed-size 1G --ondisk mmcblk0 --fstype=ext4 --label rootfs_A --align 4096
part / --source rootfs --fixed-size 1G --ondisk mmcblk0 --fstype=ext4 --label rootfs_B --align 4096
part /data --fixed-size 100M --ondisk mmcblk0 --fstype=ext4 --label data --align 4096
```
