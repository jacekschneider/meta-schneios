## conf/distro/schneios.conf
```bitbake
require conf/distro/poky.conf

DISTRO = "schneios"
DISTRO_NAME = "SchneiOS"
DISTRO_VERSION = "1.0.0"
DISTRO_CODENAME = "wrynose"

MAINTAINER = "Jacek Schneider <schneiderautomatyka@gmail.com>"


DISTRO_FEATURES:append = " usrmerge"
DISTRO_FEATURES:append = " systemd"
DISTRO_FEATURES:remove = " sysvinit"
DISTRO_FEATURES:append = " x11"
DISTRO_FEATURES:append = " rauc"
DISTRO_FEATURES:append = " opengl"
DISTRO_FEATURES:append = " wayland"
DISTRO_FEATURES:append = " pam"

VIRTUAL-RUNTIME_init_manager = "systemd"
```

## conf/machine/rpi4-elts.conf
```bitbake
#@TYPE: Machine
#@NAME: RaspberryPi 4 Development Board (64bit)
#@DESCRIPTION: Machine configuration for the RaspberryPi 4 in 64 bits mode

MACHINEOVERRIDES =. "raspberrypi4:"

MACHINE_FEATURES += "pci"
MACHINE_EXTRA_RRECOMMENDS += "\
    linux-firmware-rpidistro-bcm43455 \
    bluez-firmware-rpidistro-bcm4345c0-hcd \
    linux-firmware-rpidistro-bcm43456 \
    bluez-firmware-rpidistro-bcm4345c5-hcd \
"

EXTRA_IMAGE_FEATURES ?= "debug-tweaks"

IMAGE_FSTYPES = "ext4 wic wic.gz"
RPI_USE_U_BOOT = "1"
ENABLE_UART = "1"
ENABLE_I2C = "1"


require conf/machine/include/arm/armv8a/tune-cortexa72.inc
include conf/machine/include/rpi-base.inc

RPI_KERNEL_DEVICETREE = " \
    broadcom/bcm2711-rpi-4-b.dtb \
    broadcom/bcm2711-rpi-400.dtb \
    broadcom/bcm2711-rpi-cm4.dtb \
    broadcom/bcm2711-rpi-cm4s.dtb \
"

SDIMG_KERNELIMAGE ?= "kernel8.img"
SERIAL_CONSOLES ?= "115200;ttyS0"

UBOOT_MACHINE = "rpi_arm64_config"

VC4DTBO ?= "vc4-kms-v3d"

KERNEL_IMAGETYPE_UBOOT ?= "Image"
KERNEL_IMAGETYPE_DIRECT ?= "Image"
KERNEL_BOOTCMD ?= "booti"

ARMSTUB ?= "armstub8-gic.bin"


WKS_FILE = "elts-sdimage-raspberrypi.wks"

RPI_EXTRA_CONFIG = '\
dtparam=i2c_arm=on \n\
dtparam=spi=on \n\
enable_uart=1 \n\
dtoverlay=tft35a:rotate=90 \n\
dtoverlay=custom-mcp23017 \n\
dtoverlay=custom-trigger'

IMAGE_BOOT_FILES:append = " tft35a.dtbo;overlays/tft35a.dtbo" 
```
